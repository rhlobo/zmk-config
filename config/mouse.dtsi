// Mouse emulation: acceleration profiles for &mmv / &msc and the MOVE_* / SCROLL_*
// values used by the Move layer in corne.keymap.
#define ZMK_POINTING_DEFAULT_MOVE_VAL 1250  // upstream default 600
// With smooth scrolling (both conf files) the host counts 16 units per wheel notch: 160 units/s
// is about 10 notches per second.
#define ZMK_POINTING_DEFAULT_SCRL_VAL 160   // upstream default 10
#include <dt-bindings/zmk/pointing.h>


// MOUSE CONFIGS
// Mouse movement: Configurable acceleration profile with three parameters:
// - delay before movement
// - time to max speed
// - acceleration exponent: The exponent is usually set to:
//   - 0 for constant speed
//   - 1 for uniform acceleration
//   - 2 for uniform jerk
&mmv {
    acceleration-exponent=<1>;
    time-to-max-speed-ms = <1500>;
    delay-ms = <0>;
};

// Scrolling: Configurable acceleration profile with three parameters. With smooth scrolling,
// ZMK ignores the acceleration on hosts that accept high-resolution scrolling (Windows,
// Linux) and scrolls at constant speed; it applies only on hosts that do not (macOS):
// - delay before movement
// - time to max speed
// - acceleration exponent: The exponent is usually set to:
//   - 0 for constant speed
//   - 1 for uniform acceleration
//   - 2 for uniform jerk
&msc {
    acceleration-exponent=<1>;
    time-to-max-speed-ms = <3000>;
    delay-ms = <0>;
};


// Names used by the keymap; SCRL_* are the upstream names for the same values.
#define SCROLL_UP SCRL_UP
#define SCROLL_DOWN SCRL_DOWN
#define SCROLL_LEFT SCRL_LEFT
#define SCROLL_RIGHT SCRL_RIGHT
